## CMakeLists.txt
```
#
# Copyright (c) 2024 Nordic Semiconductor
#
# SPDX-License-Identifier: LicenseRef-Nordic-5-Clause
#
cmake_minimum_required(VERSION 3.20.0)

# Include overlay file
set(EXTRA_DTC_OVERLAY_FILE ${CMAKE_CURRENT_SOURCE_DIR}/../../../applications/nrf_audio/boards/nrf5340_audio_dk_nrf5340_cpuapp.overlay)

# Flag which defines whether application is compiled as gateway/dongle or headset
add_compile_definitions(HEADSET=1)
add_compile_definitions(GATEWAY=2)


find_package(Zephyr REQUIRED HINTS $ENV{ZEPHYR_BASE})
project(nrf_auraconfig)

# Include application events and configuration headers
zephyr_library_include_directories(app PRIVATE
    ${ZEPHYR_NRF_MODULE_DIR}/samples/bluetooth/nrf_auraconfig/include
    ${ZEPHYR_NRF_MODULE_DIR}/applications/nrf_audio/include
    ${ZEPHYR_NRF_MODULE_DIR}/applications/nrf_audio/src/bluetooth
    ${ZEPHYR_NRF_MODULE_DIR}/applications/nrf_audio/src/modules
    ${ZEPHYR_NRF_MODULE_DIR}/applications/nrf_audio/src/utils/macros
    ${ZEPHYR_NRF_MODULE_DIR}/applications/nrf_audio/src/audio
    ${ZEPHYR_NRF_MODULE_DIR}/applications/nrf_audio/src/utils
    ${ZEPHYR_NRF_MODULE_DIR}/applications/nrf_audio/src/drivers
)

add_subdirectory(${ZEPHYR_NRF_MODULE_DIR}/applications/nrf_audio/src/bluetooth bluetooth_build)

target_sources(app PRIVATE ${ZEPHYR_NRF_MODULE_DIR}/applications/nrf_audio/src/modules/audio_sync_timer.c)
target_sources(app PRIVATE ${ZEPHYR_NRF_MODULE_DIR}/applications/nrf_audio/src/modules/led.c)

target_sources_ifdef(CONFIG_NRF_AUDIO_SD_CARD_MODULE app PRIVATE ${ZEPHYR_NRF_MODULE_DIR}/applications/nrf_audio/src/modules/sd_card.c)
target_sources_ifdef(CONFIG_NRF_AUDIO_SD_CARD_LC3_FILE app PRIVATE ${ZEPHYR_NRF_MODULE_DIR}/applications/nrf_audio/src/modules/lc3_file.c)
target_sources_ifdef(CONFIG_NRF_AUDIO_SD_CARD_LC3_STREAMER app PRIVATE ${ZEPHYR_NRF_MODULE_DIR}/applications/nrf_audio/src/modules/lc3_streamer.c)

FILE(GLOB app_sources src/*.c)

target_sources(app PRIVATE ${app_sources})

target_sources(app PRIVATE
    ${ZEPHYR_NRF_MODULE_DIR}/applications/nrf_audio/src/audio/audio_system.c
    ${ZEPHYR_NRF_MODULE_DIR}/applications/nrf_audio/src/audio/audio_datapath.c
    ${ZEPHYR_NRF_MODULE_DIR}/applications/nrf_audio/src/audio/sw_codec_select.c
    ${ZEPHYR_NRF_MODULE_DIR}/applications/nrf_audio/src/audio/le_audio_rx.c
    ${ZEPHYR_NRF_MODULE_DIR}/applications/nrf_audio/src/modules/audio_usb.c
    ${ZEPHYR_NRF_MODULE_DIR}/applications/nrf_audio/src/modules/audio_usb_init.c
    ${ZEPHYR_NRF_MODULE_DIR}/applications/nrf_audio/src/modules/audio_clock.c
    ${ZEPHYR_NRF_MODULE_DIR}/applications/nrf_audio/src/utils/device_location.c
    ${ZEPHYR_NRF_MODULE_DIR}/applications/nrf_audio/src/utils/uicr.c
)
```

## Kconfig
```
#
# Copyright (c) 2024 Nordic Semiconductor ASA
#
# SPDX-License-Identifier: LicenseRef-Nordic-5-Clause
#



config TRANSPORT_BIS
	bool "Use BIS (Broadcast Isochronous Stream)"

config NRF_AURACONFIG
	bool "nRF Auraconfig"
	depends on TRANSPORT_BIS
	select EXPERIMENTAL
	default y

config AUDIO_DEV
	int "Select which device type to compile for. 1=HEADSET or 2=GATEWAY"
	range 1 2
	default 2
	help
	  Setting this variable to 1 selects that the project is compiled
	  as a HEADSET device.
	  Setting to 2 will compile as a GATEWAY.


	 
rsource "Kconfig.defaults"
rsource "$(ZEPHYR_NRF_MODULE_DIR)/applications/nrf_audio/src/audio/Kconfig"
rsource "$(ZEPHYR_NRF_MODULE_DIR)/applications/nrf_audio/src/bluetooth/Kconfig"
rsource "$(ZEPHYR_NRF_MODULE_DIR)/applications/nrf_audio/src/modules/Kconfig"
rsource "$(ZEPHYR_NRF_MODULE_DIR)/applications/nrf_audio/src/utils/Kconfig"


menu "Logging"

module = MAIN
module-str = main
source "subsys/logging/Kconfig.template.log_config"

config PRINT_STACK_USAGE_MS
	depends on THREAD_ANALYZER && INIT_STACKS
	int "Print stack usage every x milliseconds"
	default 5000

endmenu # Log levels

source "Kconfig.zephyr"


menu "PSCM"

module = PSCM
module-str = pscm
source "subsys/logging/Kconfig.template.log_config"

endmenu


menuconfig APP_NRF_AUDIO
	 bool "nRF Audio [EXPERIMENTAL]"
	 select EXPERIMENTAL
```

## prj.conf
```kconfig
#
# Copyright (c) 2024 Nordic Semiconductor ASA
#
# SPDX-License-Identifier: LicenseRef-Nordic-5-Clause
#

# General
CONFIG_REBOOT=y
CONFIG_DEBUG=y
CONFIG_ASSERT=y
CONFIG_STACK_USAGE=y
CONFIG_THREAD_RUNTIME_STATS=y
CONFIG_MAIN_THREAD_PRIORITY=10
CONFIG_STACK_SENTINEL=y
CONFIG_INIT_STACKS=y
# 12000
CONFIG_MAIN_STACK_SIZE=16000
CONFIG_THREAD_NAME=y
# 2000
CONFIG_SYSTEM_WORKQUEUE_STACK_SIZE=4096
CONFIG_NET_BUF_POOL_USAGE=y

# Uart driver
CONFIG_SERIAL=y

# Logging
CONFIG_LOG=y
CONFIG_NEWLIB_LIBC_FLOAT_PRINTF=y
CONFIG_LOG_TAG_MAX_LEN=2
CONFIG_LOG_TAG_DEFAULT="--"

CONFIG_LOG_BUFFER_SIZE=4096
CONFIG_USE_SEGGER_RTT=n
CONFIG_LOG_BACKEND_RTT=n

CONFIG_SOC_NRF53_CPUNET_ENABLE=y

CONFIG_ZBUS=y
CONFIG_ZBUS_RUNTIME_OBSERVERS=y
CONFIG_ZBUS_MSG_SUBSCRIBER=y
CONFIG_ZBUS_MSG_SUBSCRIBER_NET_BUF_POOL_SIZE=20

CONFIG_REGULATOR=y
CONFIG_CONTIN_ARRAY=y
CONFIG_DATA_FIFO=y

# Enable NRFX_CLOCK for ACLK control
CONFIG_NRFX_CLOCK=y
CONFIG_NEWLIB_LIBC=y

# Audio codec LC3 related defines
# FPU_SHARING enables preservation of the hardware floating point registers
# across context switches to allow multiple threads to perform concurrent
# floating point operations.
CONFIG_FPU=y
CONFIG_FPU_SHARING=y

# Enable SDHC interface
CONFIG_DISK_DRIVERS=y
CONFIG_DISK_DRIVER_SDMMC=y

# Allocate buffer on RAM for transferring chunck of data
# from Flash to SPI
CONFIG_SPI_NRFX_RAM_BUFFER_SIZE=8

# CONFIG_the file system
CONFIG_FILE_SYSTEM=y
CONFIG_FAT_FILESYSTEM_ELM=y
CONFIG_FS_FATFS_LFN=y
CONFIG_FS_FATFS_LFN_MODE_STACK=y

# exFAT enabled to support longer file names and higher transfer speed
CONFIG_FS_FATFS_EXFAT=y
CONFIG_FS_FATFS_MAX_LFN=255

# Enable SPI interface
CONFIG_SPI=y

# Enable ADC for board version readback
CONFIG_ADC=y
CONFIG_WATCHDOG=y
CONFIG_TASK_WDT=y

# Use this for debugging thread usage
#CONFIG_LOG_THREAD_ID_PREFIX=y

# Console related defines
CONFIG_CONSOLE=y
CONFIG_UART_CONSOLE=y

# Shell related defines
CONFIG_SHELL=y
CONFIG_KERNEL_SHELL=y
CONFIG_SHELL_BACKEND_SERIAL=y
CONFIG_SHELL_VT100_COMMANDS=y
CONFIG_SHELL_VT100_COLORS=y
CONFIG_SHELL_STACK_SIZE=8096
CONFIG_SHELL_CMD_BUFF_SIZE=128
CONFIG_SHELL_DEFAULT_TERMINAL_WIDTH=120

## Reduce shell memory usage
CONFIG_SHELL_WILDCARD=n
CONFIG_SHELL_HELP_ON_WRONG_ARGUMENT_COUNT=n
CONFIG_SHELL_STATS=n
CONFIG_SHELL_CMDS=n
CONFIG_SHELL_HISTORY=y

# Turn off default shell commands
CONFIG_I2C_SHELL=n
CONFIG_HWINFO_SHELL=n
CONFIG_CLOCK_CONTROL_NRF_SHELL=n
CONFIG_FLASH_SHELL=n
CONFIG_DEVICE_SHELL=n

# Suppress LOG_ERR messages from sd_check_card_type. Because SPI_SDHC has no card presence method,
# assume card is in slot. Thus error message is always shown if card is not inserted
CONFIG_SD_LOG_LEVEL_OFF=y

# Suppress LOG_INF messages from hci_core
CONFIG_BT_HCI_CORE_LOG_LEVEL_WRN=y

## ISO related configs ##
CONFIG_BT=y
CONFIG_UTF8=y
CONFIG_BT_DEVICE_NAME_DYNAMIC=y
CONFIG_BT_CAP_INITIATOR=y

CONFIG_BT_ISO_BROADCASTER=y
CONFIG_BT_ISO_MAX_BIG=2
CONFIG_BT_ISO_MAX_CHAN=8
CONFIG_BT_ISO_TX_BUF_COUNT=3

CONFIG_BT_BAP_BROADCAST_SOURCE=y
CONFIG_BT_BAP_BROADCAST_SRC_COUNT=2
CONFIG_BT_EXT_ADV_MAX_ADV_SET=2
CONFIG_BT_BAP_BROADCAST_SRC_SUBGROUP_COUNT=4
CONFIG_BT_BAP_BROADCAST_SRC_STREAM_COUNT=8

# Broadcasting Device - 0x0885
CONFIG_BT_DEVICE_APPEARANCE=2181

CONFIG_TRANSPORT_BIS=y
CONFIG_BT_AUDIO_BROADCAST_CONFIGURABLE=y
CONFIG_BT_AUDIO_BROADCAST_ZBUS_EVT_STREAM_SENT=y

CONFIG_LE_AUDIO_MSG_SUB_THREAD_PRIO=3

# CONFIG_SW_CODEC_NONE=y

CONFIG_NRF_AUDIO_SD_CARD_MODULE=y
CONFIG_NRF_AUDIO_SD_CARD_LC3_FILE=y
CONFIG_NRF_AUDIO_SD_CARD_LC3_STREAMER=y

CONFIG_SD_CARD_LC3_STREAMER_STACK_SIZE=8000
CONFIG_MODULE_SD_CARD_LOG_LEVEL_WRN=y

CONFIG_AUDIO_SOURCE_I2S=n


# USB 추가
CONFIG_POLL=y
CONFIG_APP_NRF_AUDIO=y
CONFIG_SAMPLE_RATE_CONVERTER=y
CONFIG_SAMPLE_RATE_CONVERTER_FILTER_SIMPLE=y
CONFIG_SPEED_OPTIMIZATIONS=y

# General
CONFIG_BT_RX_STACK_SIZE=2500

CONFIG_UDC_BUF_COUNT=16
CONFIG_HEAP_MEM_POOL_SIZE=32768
CONFIG_UDC_BUF_POOL_SIZE=8192


CONFIG_LC3_ENC_CHAN_MAX=2
CONFIG_AUDIO_ENCODE_CHANNELS_MAX=2
```

## include/nrf_auraconfig.h
```c
/*
 * Copyright (c) 2024 Nordic Semiconductor ASA
 *
 * SPDX-License-Identifier: LicenseRef-Nordic-5-Clause
 */

#ifndef _NRF_AURACONFIG_H_
#define _NRF_AURACONFIG_H_

#include <zephyr/net_buf.h>


/**
 * @defgroup auraconfig nRF Auraconfig
 * @brief nRF Auraconfig
 *
 * @{
 */

 /**
 * @brief Main function for the Auraconfig sample.
 */
void nrf_auraconfig_main(void);

// modified code
void stream_frame_send(struct net_buf *audio_kor, struct net_buf *audio_eng);
/** @} */

#endif /* _NRF_AURACONFIG_H_ */
```
